## conf/layer.conf
```bitbake
# We have a conf and classes directory, add to BBPATH
BBPATH .= ":${LAYERDIR}"

# We have a recipes directory, add to BBFILES
BBFILES += "${LAYERDIR}/recipes-*/*/*.bb \
            ${LAYERDIR}/recipes-*/*/*.bbappend"

# Add the name of the layer to the layer collections
BBFILE_COLLECTIONS += "meta-ricoboard"

# Set the recipe file search pattern
BBFILE_PATTERN_meta-ricoboard := "^${LAYERDIR}/"

# Set the priority of this layer
BBFILE_PRIORITY_meta-ricoboard = "6"

# Specify other layers this layer depends on. This is a white space
# delimited list of layer names.
LAYERDEPENDS_meta-ricoboard = "meta-ti"
LAYERVERSION_meta-ricoboard = "1"
```

## conf/machine/ricoboard.conf
```bitbake
#@TYPE: Machine
#@NAME: RicoBoard machine
#@DESCRIPTION: Machine configuration for the http://www.myirtech.com Rico Board (TI AM437x)

require conf/machine/include/ti43x.inc

PREFERRED_PROVIDER_virtual/kernel = "linux-ti-staging"
PREFERRED_VERSION_linux-ti-staging = "4.4.%"

KERNEL_DEVICETREE = "am437x-myir-ricoboard.dtb"
SERIAL_CONSOLE = "115200 ttyS0"

DEFAULTTUNE = "cortexa9hf-neon"
```
